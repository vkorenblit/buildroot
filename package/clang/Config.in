## package/clang/Config.in
```kconfig
config BR2_PACKAGE_CLANG
	bool "clang"
	depends on BR2_PACKAGE_LLVM_ARCH_SUPPORTS
	select BR2_PACKAGE_LLVM
	help
	  Clang is a C/C++, Objective C/C++ and OpenCL C front-end
	  for the LLVM compiler.

	  http://clang.llvm.org
```

## package/clinfo/Config.in
```kconfig
config BR2_PACKAGE_CLINFO
	bool "clinfo"
	depends on BR2_PACKAGE_MESA3D_OPENCL
	help
	  clinfo is a simple command-line application that enumerates
	  all possible (known) properties of the OpenCL platform and
	  devices available on the system.

	  https://github.com/Oblomov/clinfo
```

## package/easycl/Config.in
```kconfig
config BR2_PACKAGE_EASYCL
	bool "easycl"
	help
	  Easy to run kernels using OpenCL
```

## package/libclc/Config.in
```kconfig
config BR2_PACKAGE_LIBCLC
	bool "libclc"
	depends on BR2_PACKAGE_LLVM_ARCH_SUPPORTS
	depends on BR2_HOST_GCC_AT_LEAST_4_8
	depends on BR2_TOOLCHAIN_GCC_AT_LEAST_4_8
	depends on BR2_TOOLCHAIN_HAS_THREADS
	depends on BR2_INSTALL_LIBSTDCPP
	depends on !BR2_TOOLCHAIN_HAS_GCC_BUG_64735 # std::shared_future
	depends on !BR2_STATIC_LIBS
	depends on BR2_USE_WCHAR # std::wstring
	help
	  libclc is an open source, BSD licensed implementation of
	  the library requirements of the OpenCL C programming language,
	  as specified by the OpenCL 1.1 Specification.

	  http://libclc.llvm.org/

comment "libclc needs a toolchain w/ wchar, threads, C++, gcc >= 4.8, host gcc >= 4.8, dynamic library"
	depends on BR2_PACKAGE_LLVM_ARCH_SUPPORTS
	depends on !BR2_TOOLCHAIN_HAS_THREADS || !BR2_INSTALL_LIBSTDCPP || \
		!BR2_HOST_GCC_AT_LEAST_4_8 || !BR2_TOOLCHAIN_GCC_AT_LEAST_4_8 \
		|| BR2_STATIC_LIBS || !BR2_USE_WCHAR
```

## package/llvm/Config.in
```kconfig
config BR2_PACKAGE_LLVM_ARCH_SUPPORTS
	bool
	default y if BR2_i386
	default y if BR2_x86_64

config BR2_PACKAGE_LLVM_TARGET_ARCH
	string
	default "X86" if BR2_i386 || BR2_x86_64

config BR2_PACKAGE_LLVM
	bool "llvm"
	depends on BR2_PACKAGE_LLVM_ARCH_SUPPORTS
	depends on BR2_HOST_GCC_AT_LEAST_4_8
	depends on BR2_TOOLCHAIN_GCC_AT_LEAST_4_8
	help
	  The LLVM Project is a collection of modular and reusable
	  compiler and toolchain technologies.

	  http://llvm.org

if BR2_PACKAGE_LLVM

config BR2_PACKAGE_LLVM_AMDGPU
	bool "AMDGPU backend"
	help
	  Build AMDGPU target. Select this option if you are going
	  to install mesa3d with llvm and use Gallium Radeon driver.

endif

comment "llvm needs a toolchain w/ gcc >= 4.8, host gcc >= 4.8"
	depends on !BR2_HOST_GCC_AT_LEAST_4_8 \
		|| !BR2_TOOLCHAIN_GCC_AT_LEAST_4_8
```

## package/ocl-icd/Config.in
```kconfig
config BR2_PACKAGE_OCL_ICD
	bool "ocl-icd"
	help
	  This package aims at creating an Open Source alternative to
	  vendor specific OpenCL ICD loaders.
```

## package/vc4c/Config.in
```kconfig
config BR2_PACKAGE_VC4C
	bool "vc4c"
	depends on BR2_PACKAGE_LLVM_ARCH_SUPPORTS
	depends on BR2_HOST_GCC_AT_LEAST_4_8
	depends on BR2_TOOLCHAIN_GCC_AT_LEAST_4_9 # C++14
	depends on BR2_TOOLCHAIN_HAS_THREADS
	depends on BR2_INSTALL_LIBSTDCPP
	depends on !BR2_TOOLCHAIN_HAS_GCC_BUG_64735 # std::shared_future
	depends on !BR2_STATIC_LIBS
	depends on BR2_USE_WCHAR # std::wstring
	depends on BR2_arm # rpi-userland
	select BR2_PACKAGE_RPI_USERLAND
	select BR2_PACKAGE_VC4CLSTDLIB
	select BR2_PACKAGE_CLANG
	help
	  Compiler for the VC4CL OpenCL-implementation.

comment "clang needs a toolchain w/ wchar, threads, C++, gcc >= 4.8, host gcc >= 4.8, dynamic library"
	depends on BR2_PACKAGE_LLVM_ARCH_SUPPORTS
	depends on !BR2_TOOLCHAIN_HAS_THREADS || !BR2_INSTALL_LIBSTDCPP || \
		!BR2_HOST_GCC_AT_LEAST_4_8 || !BR2_TOOLCHAIN_GCC_AT_LEAST_4_8 \
		|| BR2_STATIC_LIBS || !BR2_USE_WCHAR
```

## package/vc4cl/Config.in
```kconfig
config BR2_PACKAGE_VC4CL
	bool "vc4cl"
	depends on BR2_PACKAGE_LLVM_ARCH_SUPPORTS
	depends on BR2_HOST_GCC_AT_LEAST_4_8
	depends on BR2_TOOLCHAIN_GCC_AT_LEAST_4_9 # C++14
	depends on BR2_TOOLCHAIN_HAS_THREADS
	depends on BR2_INSTALL_LIBSTDCPP
	depends on !BR2_TOOLCHAIN_HAS_GCC_BUG_64735 # std::shared_future
	depends on !BR2_STATIC_LIBS
	depends on BR2_USE_WCHAR # std::wstring
	depends on BR2_arm # rpi-userland
	select BR2_PACKAGE_OCL_ICD
	select BR2_PACKAGE_VC4C
	help
	  VC4CL is an implementation of the OpenCL 1.2 (EMBEDDED PROFILE)
	  standard for the VideoCore IV GPU (found in all Raspberry Pi models).
```

## package/vc4clstdlib/Config.in
```kconfig
config BR2_PACKAGE_VC4CLSTDLIB
	bool "vc4clstdlib"
	help
	  VC4CLStdLib contains the VC4CL implementation of the OpenCL
	  standard-library and is required to build the VC4C compiler.
```
